## boards/shields/aerogrid_60/Kconfig.defconfig
```kconfig
if SHIELD_AEROGRID_60_LEFT

config ZMK_KEYBOARD_NAME
    default "aerogrid_60"

endif

if SHIELD_AEROGRID_60_LEFT || SHIELD_AEROGRID_60_RIGHT

config ZMK_SPLIT
    default y

endif
```

## boards/shields/aerogrid_60/Kconfig.shield
```kconfig
config SHIELD_AEROGRID_60_LEFT
    def_bool $(shields_list_contains,aerogrid_60_left)
config SHIELD_AEROGRID_60_RIGHT
    def_bool $(shields_list_contains,aerogrid_60_right)
```
